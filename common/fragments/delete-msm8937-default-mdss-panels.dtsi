&mdss_mdp {
    /delete-node/ qcom,mdss_dsi_sim_video;
    /delete-node/ qcom,mdss_dsi_sim_cmd;
    /delete-node/ qcom,mdss_dsi_truly_1080p_video;
    /delete-node/ qcom,mdss_dsi_truly_1080p_cmd;
    /delete-node/ qcom,mdss_dsi_truly_720p_video;
    /delete-node/ qcom,mdss_dsi_truly_720p_cmd;
    /delete-node/ qcom,mdss_dsi_r69006_1080p_cmd;
    /delete-node/ qcom,mdss_dsi_r69006_1080p_video;
    /delete-node/ qcom,qcom,mdss_dsi_hx8394f_720p_video;
    /delete-node/ qcom,mdss_dsi_adv7533_1080p;
    /delete-node/ qcom,mdss_dsi_adv7533_720p;
    /delete-node/ qcom,mdss_dsi_hx8399c_truly_video;
    /delete-node/ qcom,mdss_dsi_hx8399c_hd_video;
    /delete-node/ qcom,mdss_dsi_nt35695b_truly_fhd_video;
    /delete-node/ qcom,mdss_dsi_nt35695b_truly_fhd_cmd;
    /delete-node/ qcom,mdss_dsi_icn9706_720_1440p_video;
    /delete-node/ qcom,mdss_dsi_edo_rm67162_qvga_cmd;
};
